   

#include "reg51.h"
#include "absacc.h"
#define unchar  unsigned char
#define unint   unsigned int 
//--------------------------------------------------------- 4线SPI接口 驱动
																		  
sbit    RSTB	=P1^3;

sbit    SDI     =P1^0;
sbit	SCL		=P1^1;
sbit    CS0  	=P1^4;
sbit    RS      =P1^2;

sbit    KEY	    =P3^2;

unchar code graphic1[]=
{

/*--  宽度x高度=128x64  --*/
0xFF,0x01,0x01,0x01,0x01,0x01,0x01,0x01,0x01,0x01,0x01,0x01,0x01,0x01,0x01,0x01,
0x01,0x01,0x01,0x01,0x01,0x01,0x01,0x01,0x01,0x01,0x01,0x01,0x01,0x01,0x01,0x01,
0x01,0x01,0x01,0x01,0x01,0x81,0xC1,0x41,0x41,0x41,0x01,0x01,0x01,0x01,0x01,0x01,
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0x80,0x80,0x80,0x80,0x80,0x80,0x80,0x80,0x80,0x80,0x80,0x80,0x80,0x80,0x80,0xFF,
};
void Init_ST7567();
void Write_ST7567_COM(unchar COMDADA_4SPI);
void Write_ST7567_DISPLAY_DATA_serial_4SPI(unchar DADA_4SPI);
void Delay_ms(unsigned long value);
void HDReset();
void Keypress(void);
void clear_screen(unchar xx);
void Display_pic1();


void main()
{	
	Init_ST7567();
	while(1)
	{
	 clear_screen(0x00);
	Delay_ms(1000);
	 clear_screen(0xff);
	Delay_ms(1000);
	 clear_screen(0x55);
	Delay_ms(1000);
	 clear_screen(0xaa);
	Delay_ms(1000);
	 clear_screen(0x33);
	 Display_pic1();
	 Keypress();
	 }

}

//--------------------------------------------------------------------------

void Init_ST7567()
{
	HDReset();
	Delay_ms(100);

       Write_ST7567_COM(0xe2);	 //Soft rest

       Write_ST7567_COM(0xa2);	 //SET LCD bias(A2-1/9bias; A3-1/7bias)
       Write_ST7567_COM(0xa0);	 //SET ADC NORMAL(OB-POR seg0-00h) A0: NORMAL  A1: REVERSE
       Write_ST7567_COM(0xc8);	   //SET COM OUTPUT SCAN DIRECTION(0XXXB-NORMAL)-POR  COM63-->COM0
	   	   
       Write_ST7567_COM(0xa4);	   // SET DISPLAY NORMAL (0B-NORMAL)-POR  A4:NORMAL A5:ENTIRE DISPLAY ON
       Write_ST7567_COM(0xa6);	   //SET NORMAL DISPLAY MODE(0B-NORMAL)  A6:NORMAL  A7:REVERSE
       Write_ST7567_COM(0x25);	   //SET INTERNAL REGULATOR RESDASTOR RATIO(100B)-POR

       Write_ST7567_COM(0x81);
	   	   
       Write_ST7567_COM(0x1a);	   // SET CONTRAST CONTROL REGISTER(00,0000H-11,1111H) 30  对比度请修改此值，调浓增大此值，反之调淡。
       Write_ST7567_COM(0x2f);	   //SET POWER CONTROL REGISTER (ALL INTERNAL)

       Write_ST7567_COM(0x40);	   //end of initialzation
       Write_ST7567_COM(0xaf);	   //DisPlay On

}


void clear_screen(unchar xx)
{
unchar i,j;
for(i=0;i<9;i++)
	{
		CS0=0;
		Write_ST7567_COM(0xb0+i);
	    Write_ST7567_COM(0x10);
		Write_ST7567_COM(0x00);
		for(j=0;j<132;j++)
		{
			Write_ST7567_DISPLAY_DATA_serial_4SPI(xx);
		}
	 }
}

void Display_pic1()
{
	unint i,j,adressd=0;

	for(i=0;i<8;i++)
	{
		CS0=0;
		Write_ST7567_COM(0xb0+i);
	    Write_ST7567_COM(0x10);
		Write_ST7567_COM(0x00);
		for(j=0;j<128;j++)
		{
			Write_ST7567_DISPLAY_DATA_serial_4SPI(graphic1[adressd]);
			adressd++;
		}
	}
} 
//***************************************************************************SPI4
void Write_ST7567_COM(unchar COMDADA_4SPI)
{
	unchar bit8;
	RS=0;
	CS0=0;
	for(bit8=0;bit8<8;bit8++)
	{
		SCL=0;
		if((COMDADA_4SPI&0x80)==0x80)
		SDI=1;
		else		
		SDI=0;
//		SCL=0;
		SCL=1;
		COMDADA_4SPI=(COMDADA_4SPI<<1);

	}
  //  CS1=1;
			
}

void Write_ST7567_DISPLAY_DATA_serial_4SPI(unchar DADA_4SPI)
{   
	unchar bit8;
	RS=1;
	CS0=0;				

	for(bit8=0;bit8<8;bit8++)
	{
		SCL=0;
		if((DADA_4SPI&0x80)==0x80)
		SDI=1;
		else
		SDI=0;
		SCL=1;
		DADA_4SPI=(DADA_4SPI<<1);

	}
//	CS1=1;
}

		
void Delay_ms(unsigned long value)
{
	unint i,j;
    for (i=0;i<value;i++)
		for (j=0;j<500;j++);
}

void HDReset()
{
	RSTB=0;
	Delay_ms(2);
	RSTB=1;
	Delay_ms(4);
}

void Keypress()
	{
	while(KEY)
	Delay_ms(10);
	}           	